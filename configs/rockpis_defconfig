## configs/rockpis_defconfig
```kconfig
BR2_aarch64=y
BR2_cortex_a35=y
BR2_DL_DIR="$(BASE_DIR)/../../buildroot.dl"
BR2_CCACHE=y
BR2_GLOBAL_PATCH_DIR="$(BR2_EXTERNAL)/patches.rockpis"
BR2_TOOLCHAIN_BUILDROOT_GLIBC=y
BR2_KERNEL_HEADERS_4_4=y
BR2_TARGET_GENERIC_HOSTNAME="rockpis"
BR2_TARGET_GENERIC_ISSUE="Rock Pi S by Shreyas"
BR2_INIT_SYSTEMD=y
BR2_SYSTEM_DHCP="eth0"
BR2_SYSTEM_DEFAULT_PATH="/bin:/sbin:/usr/bin:/usr/sbin"
BR2_ROOTFS_OVERLAY="$(BR2_EXTERNAL)/overlays"
BR2_ROOTFS_POST_BUILD_SCRIPT="$(BR2_EXTERNAL)/board/RK3308/post-build.sh"
BR2_ROOTFS_POST_IMAGE_SCRIPT="$(BR2_EXTERNAL)/board/RK3308/post-image.sh"
BR2_ROOTFS_POST_SCRIPT_ARGS="RK3308"
BR2_LINUX_KERNEL=y
BR2_LINUX_KERNEL_CUSTOM_GIT=y
BR2_LINUX_KERNEL_CUSTOM_REPO_URL="https://github.com/piter75/rockchip-kernel.git"
BR2_LINUX_KERNEL_CUSTOM_REPO_VERSION="6c923e306e11a9fa60bae4c319bdb0da9ba38f08"
BR2_LINUX_KERNEL_DEFCONFIG="rk3308_linux"
BR2_LINUX_KERNEL_CONFIG_FRAGMENT_FILES=" $(BR2_EXTERNAL)/package/example-module-overlay/module-overlay/kernel.fragment"
BR2_LINUX_KERNEL_DTS_SUPPORT=y
BR2_LINUX_KERNEL_INTREE_DTS_NAME="rockchip/rk3308-rock-pi-s"
BR2_LINUX_KERNEL_DTB_OVERLAY_SUPPORT=y
BR2_PACKAGE_BUSYBOX_CONFIG_FRAGMENT_FILES="$(BR2_EXTERNAL)/board/RK3308/busybox.fragment"
BR2_PACKAGE_RNG_TOOLS=y
BR2_PACKAGE_LIBNATPMP=y
BR2_PACKAGE_COLLECTD=y
BR2_PACKAGE_COLLECTD_CONNTRACK=y
BR2_PACKAGE_HAVEGED=y
BR2_PACKAGE_AVAHI=y
BR2_PACKAGE_AVAHI_DAEMON=y
BR2_PACKAGE_BLUEZ5_UTILS=y
BR2_PACKAGE_BLUEZ5_UTILS_CLIENT=y
BR2_PACKAGE_BLUEZ5_UTILS_DEPRECATED=y
BR2_PACKAGE_BLUEZ5_UTILS_PLUGINS_NFC=y
BR2_PACKAGE_BRIDGE_UTILS=y
BR2_PACKAGE_DHCPCD=y
BR2_PACKAGE_DNSMASQ=y
BR2_PACKAGE_HOSTAPD=y
BR2_PACKAGE_HOSTAPD_WPS=y
BR2_PACKAGE_HOSTAPD_WPA3=y
BR2_PACKAGE_IPTABLES=y
BR2_PACKAGE_IPTABLES_NFTABLES=y
BR2_PACKAGE_IW=y
BR2_PACKAGE_NETSTAT_NAT=y
BR2_PACKAGE_OPENSSH=y
BR2_PACKAGE_WPA_SUPPLICANT=y
BR2_PACKAGE_SYSTEMD_RANDOMSEED=y
BR2_PACKAGE_UTIL_LINUX_RFKILL=y
BR2_TARGET_ROOTFS_EXT2=y
BR2_TARGET_ROOTFS_EXT2_4=y
BR2_TARGET_ROOTFS_EXT2_SIZE="250M"
BR2_TARGET_UBOOT=y
BR2_TARGET_UBOOT_BUILD_SYSTEM_KCONFIG=y
BR2_TARGET_UBOOT_CUSTOM_GIT=y
BR2_TARGET_UBOOT_CUSTOM_REPO_URL="https://github.com/radxa/u-boot.git"
BR2_TARGET_UBOOT_CUSTOM_REPO_VERSION="233a23e3ed0b3e5250253ee455c3c5df2080f99c"
BR2_TARGET_UBOOT_BOARD_DEFCONFIG="rock-pi-s-rk3308"
BR2_TARGET_UBOOT_CONFIG_FRAGMENT_FILES="$(BR2_EXTERNAL)/board/RK3308/uboot.fragment"
BR2_TARGET_UBOOT_NEEDS_DTC=y
BR2_PACKAGE_HOST_DOSFSTOOLS=y
BR2_PACKAGE_HOST_GENIMAGE=y
BR2_PACKAGE_HOST_MTOOLS=y
BR2_PACKAGE_HOST_UBOOT_TOOLS=y
BR2_PACKAGE_RKBIN=y
BR2_PACKAGE_RTK_HCIATTACH=y
BR2_PACKAGE_EXAMPLE_MODULE_OVERLAY=y
BR2_PACKAGE_TAILSCALE=y
```

## package/tailscale/Config.in
```kconfig
config BR2_PACKAGE_TAILSCALE
        bool "tailscale"
        help
          custom tailscale package
          https://pkgs.tailscale.com/stable/#static
```
